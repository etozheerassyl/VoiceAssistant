#ifndef CYRILLIC_FONT_H
#define CYRILLIC_FONT_H

#include <Arduino.h>
#include <Adafruit_GFX.h>

// 5x7 Cyrillic Font Bitmaps for Russian uppercase and lowercase
// Bit 0 is row 0 (top), Bit 6 is row 6 (bottom)

static const uint8_t PROGMEM font_ru_upper[33][5] = {
  {0x7E, 0x11, 0x11, 0x11, 0x7E}, // А (0x0410)
  {0x7F, 0x49, 0x49, 0x49, 0x31}, // Б (0x0411)
  {0x7F, 0x49, 0x49, 0x49, 0x36}, // В (0x0412)
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  {0x7F, 0x49, 0x49, 0x49, 0x41}  // Ё (0x0401)
};

static const uint8_t PROGMEM font_ru_lower[33][5] = {
  {0x20, 0x54, 0x54, 0x54, 0x78}, // а (0x0430)
  {0x3F, 0x48, 0x48, 0x48, 0x30}, // б (0x0431)
  {0x7C, 0x54, 0x54, 0x54, 0x28}, // в (0x0432)
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  {0x38, 0x54, 0xD4, 0x54, 0x18}  // ё (0x0451)
};

// Render single character (ASCII or Cyrillic)
inline void drawGlyph5x7(Adafruit_GFX &gfx, int16_t x, int16_t y, uint16_t unicode, uint16_t color, uint16_t bg, uint8_t size) {
  if (unicode < 128) {
    gfx.drawChar(x, y, (unsigned char)unicode, color, bg, size);
    return;
  }

  const uint8_t *bitmap = nullptr;
  if (unicode >= 0x0410 && unicode <= 0x042F) {
    bitmap = font_ru_upper[unicode - 0x0410];
  } else if (unicode == 0x0401) { // Ё
    bitmap = font_ru_upper[32];
  } else if (unicode >= 0x0430 && unicode <= 0x044F) {
    bitmap = font_ru_lower[unicode - 0x0430];
  } else if (unicode == 0x0451) { // ё
    bitmap = font_ru_lower[32];
  } else if (unicode == 0x00AB || unicode == 0x00BB) { // « or »
    // French quotes
    static const uint8_t PROGMEM q_left[5] = {0x14, 0x28, 0x50, 0x28, 0x14};
    static const uint8_t PROGMEM q_right[5] = {0x50, 0x28, 0x14, 0x28, 0x50};
    bitmap = (unicode == 0x00AB) ? q_left : q_right;
  }

  if (bitmap) {
    for (int8_t i = 0; i < 5; i++) {
      uint8_t line = pgm_read_byte(&bitmap[i]);
      for (int8_t j = 0; j < 8; j++, line >>= 1) {
        if (line & 1) {
          if (size == 1) gfx.drawPixel(x + i, y + j, color);
          else gfx.fillRect(x + i * size, y + j * size, size, size, color);
        } else if (bg != color) {
          if (size == 1) gfx.drawPixel(x + i, y + j, bg);
          else gfx.fillRect(x + i * size, y + j * size, size, size, bg);
        }
      }
    }
    // Draw space column
    if (bg != color) {
      if (size == 1) {
        for (int8_t j = 0; j < 8; j++) gfx.drawPixel(x + 5, y + j, bg);
      } else {
        gfx.fillRect(x + 5 * size, y, size, 8 * size, bg);
      }
    }
  } else {
    // Fallback space / question
    gfx.drawChar(x, y, '?', color, bg, size);
  }
}

// Measure UTF-8 string width in pixels
inline int16_t measureStringUTF8(const char *str, uint8_t size) {
  int16_t w = 0;
  const uint8_t *p = (const uint8_t*)str;
  while (*p) {
    if ((*p & 0x80) == 0) {
      p++;
    } else if ((*p & 0xE0) == 0xC0) {
      p += 2;
    } else if ((*p & 0xF0) == 0xE0) {
      p += 3;
    } else {
      p++;
    }
    w += 6 * size;
  }
  return (w > 0) ? (w - size) : 0;
}

// Draw UTF-8 string (supports Russian and ASCII)
inline void drawStringUTF8(Adafruit_GFX &gfx, int16_t x, int16_t y, const char *str, uint16_t color, uint16_t bg, uint8_t size, bool center = false) {
  if (center) {
    int16_t textWidth = measureStringUTF8(str, size);
    x = (gfx.width() - textWidth) / 2;
  }

  int16_t curX = x;
  const uint8_t *p = (const uint8_t*)str;

  while (*p) {
    uint16_t u = 0;
    if ((*p & 0x80) == 0) {
      u = *p++;
    } else if ((*p & 0xE0) == 0xC0) {
      u = ((*p & 0x1F) << 6) | (*(p + 1) & 0x3F);
      p += 2;
    } else if ((*p & 0xF0) == 0xE0) {
      u = ((*p & 0x0F) << 12) | ((*(p + 1) & 0x3F) << 6) | (*(p + 2) & 0x3F);
      p += 3;
    } else {
      p++;
      continue;
    }

    if (u == 0x0A) { // newline '\n'
      curX = x;
      y += 8 * size + 2;
      continue;
    }

    drawGlyph5x7(gfx, curX, y, u, color, bg, size);
    curX += 6 * size;
  }
}

#endif // CYRILLIC_FONT_H
